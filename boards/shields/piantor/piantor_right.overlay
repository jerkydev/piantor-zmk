#include "piantor.dtsi"

&default_transform {
    col-offset = <5>;
};

&kscan0 {
    col-gpios
        = <&pro_micro 16 GPIO_ACTIVE_HIGH> // col1
        , <&pro_micro 15 GPIO_ACTIVE_HIGH> // col2
        , <&pro_micro 14 GPIO_ACTIVE_HIGH> // col3
        , <&pro_micro 13 GPIO_ACTIVE_HIGH> // col4
        , <&pro_micro 12 GPIO_ACTIVE_HIGH> // col5
        //, <&pro_micro 11 GPIO_ACTIVE_HIGH> // col6
        ;
};